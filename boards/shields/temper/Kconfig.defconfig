## boards/shields/temper/Kconfig.defconfig
```kconfig
# Copyright (c) 2020 The ZMK Contributors
# SPDX-License-Identifier: MIT

if SHIELD_TEMPER_DONGLE

config ZMK_KEYBOARD_NAME
	default "temper"
	
config ZMK_SPLIT_ROLE_CENTRAL
	default y
	
config ZMK_USB
	default y

endif

if SHIELD_TEMPER_LEFT || SHIELD_TEMPER_RIGHT || SHIELD_TEMPER_DONGLE 

config ZMK_SPLIT
	default y
endif
```
